## configs/snapdragon_db600c_br_defconfig
```kconfig
BR2_arm=y
BR2_cortex_a15=y
BR2_ARM_FPU_NEON_VFPV4=y
BR2_TOOLCHAIN_EXTERNAL=y
BR2_PACKAGE_STRACE=y
BR2_PACKAGE_TRACE_CMD=y
BR2_PACKAGE_POWERTOP=y
BR2_PACKAGE_DROPBEAR=y
BR2_PACKAGE_ETHTOOL=y
BR2_PACKAGE_IPERF=y
BR2_PACKAGE_IPROUTE2=y
BR2_PACKAGE_IW=y
BR2_PACKAGE_WPA_SUPPLICANT=y
BR2_PACKAGE_WPA_SUPPLICANT_PASSPHRASE=y
BR2_TARGET_ROOTFS_CPIO=y
BR2_TARGET_ROOTFS_CPIO_GZIP=y
BR2_PACKAGE_HOST_ANDROID_TOOLS=y
BR2_PACKAGE_HOST_ANDROID_TOOLS_FASTBOOT=y
BR2_PACKAGE_ATH10K_FIRMWARE=y
BR2_PACKAGE_ATH10K_FIRMWARE_GIT_URL="ssh://git@bitbucket.org/erstrom/ath10k-firmware.git"
BR2_PACKAGE_ATH10K_FIRMWARE_GIT_REV="silex-sdio"
BR2_PACKAGE_ATH10K_FIRMWARE_SDIO_SILEX_SDMAC=y
```

## package/ath10k-firmware/Config.in
```kconfig
config BR2_PACKAGE_ATH10K_FIRMWARE
	bool "ath10k-firmware"
	help
	  Firmware for the Qualcomm Atheros 802.11ac Wifi devices supported
	  by the ath10k kernel driver.

if BR2_PACKAGE_ATH10K_FIRMWARE

config BR2_PACKAGE_ATH10K_FIRMWARE_GIT_URL
        string "GIT URL"
        default "https://github.com/kvalo/ath10k-firmware.git"

config BR2_PACKAGE_ATH10K_FIRMWARE_GIT_REV
        string "GIT REV"
        default "master"

choice

	bool "board"

config BR2_PACKAGE_ATH10K_FIRMWARE_USB_WUSB6100M
	bool "USB WUSB6100M"

config BR2_PACKAGE_ATH10K_FIRMWARE_USB_SPARKLAN
	bool "USB SparkLAN"

config BR2_PACKAGE_ATH10K_FIRMWARE_SDIO_SILEX_SDMAC
	bool "SDIO Silex SDMAC"

endchoice

endif
```
